## meta-piconsole/conf/distro/piconsole.conf
```bitbake
require conf/distro/poky.conf

DISTRO = "piconsole"
DISTRO_NAME = "Pi Console"
DISTRO_VERSION = "0.1"

DISTRO_FEATURES:append = " systemd wayland opengl pam usrmerge wifi bluez5 rauc"
DISTRO_FEATURES:remove = "x11"

VIRTUAL-RUNTIME_init_manager = "systemd"
VIRTUAL-RUNTIME_initscripts = ""

PACKAGE_CLASSES ?= "package_rpm"
USER_CLASSES ?= "buildstats"
PATCHRESOLVE = "noop"
```

## meta-piconsole/conf/machine/piconsole-rpi4-64.conf
```bitbake
require conf/machine/raspberrypi4-64.conf

RPI_USE_U_BOOT = "1"
ENABLE_UART = "1"
DISABLE_SPLASH = "1"
DISABLE_RPI_BOOT_LOGO = "1"
BOOT_DELAY = "0"
BOOT_DELAY_MS = "0"
GPU_MEM = "128"
IMAGE_BOOT_FILES:append = " openconsole-u-boot-splash.bmp"
EXTRA_IMAGEDEPENDS:append = " openconsole-uboot-splash"

MACHINE_FEATURES:append = " wifi bluetooth"

RPI_EXTRA_CONFIG:append = "\n# KMS/DRM for Weston, Slint, and Godot\ndtoverlay=vc4-kms-v3d\nmax_framebuffers=2\n"
```
